;Enunciado del problema
;PRÁCTICA 10.- CONTROL DE GIRO DE MOTOR A PASOS
;DISEÑE CON EL PIC16F887 UN PROGRAMA PARA CONTROLAR UN MOTOR A PASOS, DEBEN ELEGIR CON 2 BITS EL NÚMERO DE VUELTAS, 
;EN 00 CERO VUELTAS, EN 01 UNA VUELTA, EN 10 DOS VUELTAS Y 11 3 VUELTAS.
;INTEGRANTES:
;ANDRADE SALAZAR IGNACIO
;ORTIZ JIMENEZ VLADIMIR
;GUERRERO SANTANA EDGAR GEOVANNY
;FECHA: 18/09/2023

		LIST P=16F887			;INDICA EL MICRO QUE SEVA A PROGRAMAR
		INCLUDE "P16F887.INC"		;CARGA LA LIBRERIA DEL MICRO QUE USAREMOS
		DATO 	EQU 0x25			;DECLARAMOS UN REGISTRO LLAMADO DATO EN LA DIR 20 HEX
		DATO1   EQU	0X26
		R0 	EQU	0X20
		R1 	EQU	0X21
		R2 	EQU	0X22
		R3	EQU 0X23
		R4	EQU	0X24
		R5	EQU	0X27
		C1	EQU	0X28
		ORG 0x00			;INDICA QUE EL PROGRAMA EMPIEZA EN LA DIRECCIÓN 0
		GOTO INICIO			;IR A LA ETIQUETA INICIO

INICIO	BSF STATUS,RP0			;PONE EN 1 EL BIT RP0 DEL STATUS
		BSF STATUS,RP1			;PONE EN 1 EL BIT RP1 DEL STATUS (Nos mandan al banco 3)
		CLRF ANSEL			;PONE EN ENTRADAS O SALIDAS DIGITALES A LOS PORTA Y PORTE
		CLRF ANSELH				;PONE EN E/S DIGITAL EL PORTB
		CLRF TRISB			;PONE EN SALIDA AL PORTB
		BCF STATUS,RP0
		BCF STATUS,RP1			;PONE LOS BITS EN 0 Y NOS MANDA AL BANCO 0
		MOVLW b'00000000'		
		MOVWF PORTB	


LEER		MOVF 		PORTA,W			;MOVER PORTA -> W	
			XORLW		b'00000001'		;HACER LA COMPARACIÓN DE VALORES
			BTFSS		STATUS,Z		;CHECAR SI BIT Z = 1, DATO CORRECTO
			GOTO		LEER2
			MOVLW		.1
			MOVWF		C1
			CALL		VUELTA1
LEER2		MOVF 		PORTA,W			;MOVER PORTA -> W	
			XORLW		b'00000010'		;HACER LA COMPARACIÓN DE VALORES
			BTFSS		STATUS,Z		;CHECAR SI BIT Z = 1, DATO CORRECTO
			GOTO		LEER3
			MOVLW		.2
			MOVWF		C1
			CALL		VUELTA1
LEER3		MOVF 		PORTA,W			;MOVER PORTA -> W	
			XORLW		b'00000011'		;HACER LA COMPARACIÓN DE VALORES
			BTFSS		STATUS,Z		;CHECAR SI BIT Z = 1, DATO CORRECTO
			GOTO		APAGAR
			MOVLW		.3
			MOVWF		C1
			CALL		VUELTA1
			


						

VUELTAS		MOVLW b'00000001'		
			MOVWF PORTB							
			CALL	TIME
			MOVLW b'00000011'		
			MOVWF PORTB							
			CALL	TIME
			MOVLW b'00000010'		
			MOVWF PORTB							
			CALL	TIME
			MOVLW b'00000110'		
			MOVWF PORTB							
			CALL	TIME
			MOVLW b'00000100'		
			MOVWF PORTB							
			CALL	TIME
			MOVLW b'00001100'		
			MOVWF PORTB							
			CALL	TIME
			MOVLW b'00001000'		
			MOVWF PORTB							
			CALL	TIME
			MOVLW b'00001001'		
			MOVWF PORTB							
			CALL	TIME			
			DECFSZ	DATO,F
			GOTO 	VUELTAS
			DECFSZ	DATO1,F
			GOTO 	VUELTAS
			RETURN
			
			

			
APAGAR		MOVLW b'00000000'		
			MOVWF PORTB	
			GOTO	LEER

BUZZER		MOVLW	.3
			MOVWF	R5
ESO			BSF		PORTB,RB4
			CALL 	TIME2
			BCF		PORTB,RB4
			CALL 	TIME2
			DECFSZ	R5,F
			GOTO	ESO
			RETURN	

VUELTA1		MOVLW		.255
			MOVWF		DATO
			MOVLW		.2
			MOVWF		DATO1
			CALL		VUELTAS
			CALL		BUZZER
			DECFSZ		C1
			GOTO		VUELTA1
			GOTO		APAGAR
			RETURN
			
			


TIME2		MOVLW	0X5c
			MOVWF	R2
			MOVLW	0X26
			MOVWF	R3
			MOVLW	0X0b
			MOVWF	R4
			

AQUI2		DECFSZ	R2,F
			GOTO	AQUI2
			DECFSZ	R3,F
			GOTO	AQUI2
			DECFSZ	R4,F
			GOTO	AQUI
			RETURN


TIME		MOVLW	0Xfa
			MOVWF	R0
			MOVLW	0X0d
			MOVWF	R1
			

AQUI		DECFSZ	R0,F
			GOTO	AQUI
			DECFSZ	R1,F
			GOTO	AQUI
			RETURN
			END