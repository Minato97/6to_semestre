;Enunciado del problema
;PRACTICA 4
;REALICE UN PROGRAMA PARA EL PIC16F887, CON EL PUERTO A CONFIGURADO COMO ENTRADA DIGITAL Y EL B COMO SALIDA. 
;SI POR EL PUERTO A SE INTRODUCE LA CONTRASEÑA CORRECTA LOS BITS DEL PUERTO B DEBERÁN ENCENDER, 
;SI LA CONTRASEÑA ES INCORRECTA LOS BITS SE APAGARÁN. EL PROGRAMA SERÁ CÍCLICO.
;INTEGRANTES:
;ANDRADE SALAZAR IGNACIO
;ORTIZ JIMENEZ VLADIMIR
;GUERRERO SANTANA EDGAR GEOVANNY
;FECHA: 09/10/2023

			LIST P=16F887			;ELEGIR EL PIC
			INCLUDE "P16F887.INC"	;CARGA LA LIBRERIA DEL PIC
			;CONTA	EQU	0X20			
			ORG 	0X00			;INDICA EL ORIGEN DEL PROG
			GOTO	INICIO			;SALTAR A LA ETIQUETA INICIO
INICIO
			BSF	STATUS,RP0			;PONE EN 1 RP0 DEL STATUS
			BSF	STATUS,RP1			;PONE EN 1 RP1 DEL STATUS
									;ESTAS DOS INSTRUCCIONES NOS MANDADN AL BANCO 3
			CLRF	PORTB			;PORTA COMO IN/OUT DIGITAL
			CLRF	ANSEL			;PORTB COMO IN/OUT DIGITAL
			CLRF	ANSELH			;PORTB CONFIGURADO COMO OUT
			BCF	STATUS,RP0			;PONE EN 0 RP0 DEL STATUS
			BCF	STATUS,RP1			;PONE EN 0 RP1 DEL STATUS									
									;MANDAN AL BANCO 0

LEER		MOVF 	PORTA,W			;MOVER PORTA -> W
			XORLW	0X3				;HACER LA COMPARACIÓN DE VALORES
			BTFSS	STATUS,Z		;CHECAR SI BIT Z = 1, CONTRASEÑA CORRECTA
			GOTO	MAL				;SI LA CONTRASEÑA ES INCORRECTA, VA AL PROCESO EN EL QUE APAGA EL LED
			BSF	PORTB,0				;ENCENDER BIT PORQUE LA CONTRASEÑA ES CORRECTA
			BSF	PORTB,1
			BSF	PORTB,2
			BSF	PORTB,3
			BSF	PORTB,4
			BSF	PORTB,5
			BSF	PORTB,6
			BSF	PORTB,7
			GOTO	LEER

MAL			BCF	PORTB,0
			BCF	PORTB,1
			BCF	PORTB,2
			BCF	PORTB,3
			BCF	PORTB,4
			BCF	PORTB,5
			BCF	PORTB,6
			BCF	PORTB,7
			GOTO 	LEER
			END