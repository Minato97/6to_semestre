;PRÁCTICA 9.- TEMPORIZADOR 20 SEGUNDOS
;DISEÑE CON EL PIC16F887 UN TEMPORIZADOR DE 20 SEGUNDOS, 
;EL CUAL INICIARÁ CON UN 19 EN EL DISPLAY Y SE DECREMENTARÁ HASTA CERO, 
;CUANDO LA CUENTA EN EL DISPLAY LLEGUE A 0 
;UN BUZZER CONECTADO EN UN PIN DE SALIDA PITARÁ 3 VECES 
;INDICANDO LA FINALIZACIÓN. EL TEMPORIZADOR ARRANCARÁ 
;CUANDO SE PRESIONE EL BOTÓN DE RESET (RE3), 
;VOLVIENDO DE NUEVO EL DISPLAY A REGRESAR A 19 PARA QUEDAR LISTO 
;PARA OTRA ACTIVACIÓN.

;NOTA, EL BIT RE3 SERÁ CONFIGURADO COMO ENTRADA, 
;POR LO TANTO DEBERÁ SER CONSIDERADA TAL MODIFICACIÓN EN LOS BITS 
;DE CONFIGURACIÓN ANTES DE COMPILAR. EN LUGAR DE 24F4, DEBERÁ SER 24D4.
;ANDRADE SALAZAR IGNACIO
;ORTIZ JIMENEZ VLADIMIR
;GUERRERO SANTANA EDGAR GEOVANNY
;FECHA: 30/10/2023


	LIST P=16F887		;ELEGIR EL PIC
			INCLUDE "P16F887.INC"	;CARGA LA LIBRERIA DEL PIC
R0 	EQU	0X20
R1 	EQU	0X21
R2 	EQU	0X22
R3	EQU	0X23
R4	EQU	0X24
			ORG 	0X00		;INDICA EL ORIGEN DEL PROG
			GOTO	INICIO		;SALTAR A LA ETIQUETA INICIO
INICIO
			BSF	STATUS,RP0	;PONE EN 1 RP0 DEL STATUS
			BSF	STATUS,RP1	;PONE EN 1 RP1 DEL STATUS
			;ESTAS DOS INSTRUCCIONES NOS MANDADN AL BANCO 3
			CLRF	PORTB		;PORTA COMO IN/OUT DIGITAL
			CLRF	ANSEL		;PORTB COMO IN/OUT DIGITAL
			CLRF	ANSELH		;PORTB CONFIGURADO COMO OUT
			BSF	STATUS,RP0	;PONE EN 1 RP0 DEL STATUS
			BCF	STATUS,RP1	;PONE EN 0 RP1 DEL STATUS
								;MANDAN AL BANCO 1
			CLRF	TRISC		;PONE EN SALIDAS EL PORTC
			BCF	STATUS,RP0	;PONE EN 0 RP0 DEL STATUS
			BCF	STATUS,RP0	;PONE EN 0 RP1 DEL STATUS
							;MANDAN AL BANCO 0
			MOVLW	B'11101111'	;19
			MOVWF	PORTB
			BSF		PORTE,RE3								
			CALL	TIME2	

ESPERAR		CLRF 	PORTC
			BTFSC	PORTE,RE3
			GOTO 	ESPERAR

CUENTA		
			MOVLW	B'11101111'	;19
			MOVWF	PORTB
			CALL	TIME
			MOVLW	B'11111111'	;18
			MOVWF	PORTB
			CALL	TIME
			MOVLW	B'10000111'	;17
			MOVWF	PORTB
			CALL	TIME
			MOVLW	B'11111101'	;16
			MOVWF	PORTB
			CALL	TIME
			MOVLW	B'11101101'	;15
			MOVWF	PORTB
			CALL	TIME
			MOVLW	B'11100110'	;14
			MOVWF	PORTB
			CALL	TIME
			MOVLW	B'11001111'	;13
			MOVWF	PORTB
			CALL	TIME
			MOVLW	B'11011011'	;12
			MOVWF	PORTB
			CALL	TIME
			MOVLW	B'10000110'	;11
			MOVWF	PORTB
			CALL	TIME
			MOVLW	B'10111111'	;10
			MOVWF	PORTB
			CALL	TIME
			MOVLW	B'01101111'	;9
			MOVWF	PORTB
			CALL	TIME
			MOVLW	B'01111111'	;8
			MOVWF	PORTB
			CALL	TIME
			MOVLW	B'00000111'	;7
			MOVWF	PORTB
			CALL	TIME
			MOVLW	B'01111101'	;6
			MOVWF	PORTB
			CALL	TIME
			MOVLW	B'01101101'	;5
			MOVWF	PORTB
			CALL	TIME
			MOVLW	B'01100110'	;4
			MOVWF	PORTB
			CALL	TIME
			MOVLW	B'01001111'	;3
			MOVWF	PORTB
			CALL	TIME
			MOVLW	B'01011011'	;2
			MOVWF	PORTB			
			CALL	TIME
			MOVLW	B'00000110'	;1
			MOVWF	PORTB
			CALL	TIME	
			MOVLW	B'00111111'	;0
			MOVWF	PORTB			
			CALL	TIME
			CALL	BUZZER
			GOTO	ESPERAR

			
			
			

BUZZER		MOVLW	.3
			MOVWF	R3
ESO			BSF		PORTC,RC0
			CALL 	TIME
			BCF		PORTC,RC0
			CALL 	TIME
			DECFSZ	R3,F
			GOTO	ESO
			RETURN		


TIME		MOVLW	0Xac
			MOVWF	R0
			MOVLW	0X13
			MOVWF	R1
			MOVLW	0X06
			MOVWF	R2

AQUI		DECFSZ	R0,F
			GOTO	AQUI
			DECFSZ	R1,F
			GOTO	AQUI
			DECFSZ	R2,F
			GOTO	AQUI
			RETURN

TIME2		MOVLW	.255
			MOVWF	R3
			MOVLW	.13
			MOVWF	R4

AQUI2		DECFSZ	R3,F
			GOTO	AQUI2
			DECFSZ	R4,F
			GOTO	AQUI2
			RETURN
			END