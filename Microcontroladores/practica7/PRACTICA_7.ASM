;PRÁCTICA 7. CONTADOR DEL 0 A F
;REALICE UN PROGRAMA PARA EL PIC16F887 
;CON EL PUERTO A CONFIGURADO COMO ENTRADA DIGITAL 
;Y UN BIT DEL PUERTO B COMO SALIDA, 
;CUANDO SE ACTIVE UN BIT DEL PUERTO A, 
;A TRAVÉS DEL PUERTO B SE DEBERÁN MOSTRAR LOS NÚMEROS DEL 0 AL F 
;EN EL DISPLAY, SI EL BIT DE ACTIVACIÓN DE APAGA, 
;DE INMEDIATO EL DISPLAY SE APAGARÁ. EL PROGRAMA SERÁ CÍCLICO.
;ANDRADE SALAZAR IGNACIO
;ORTIZ JIMENEZ VLADIMIR
;GUERRERO SANTANA EDGAR GEOVANNY
;FECHA: 30/10/2023


	LIST P=16F887		;ELEGIR EL PIC
			INCLUDE "P16F887.INC"	;CARGA LA LIBRERIA DEL PIC
R0 	EQU	0X20
R1 	EQU	0X21
R2 	EQU	0X22
			ORG 	0X00		;INDICA EL ORIGEN DEL PROG
			GOTO	INICIO		;SALTAR A LA ETIQUETA INICIO
INICIO
			BSF	STATUS,RP0	;PONE EN 1 RP0 DEL STATUS
			BSF	STATUS,RP1	;PONE EN 1 RP1 DEL STATUS
			;ESTAS DOS INSTRUCCIONES NOS MANDADN AL BANCO 3
			CLRF	PORTB		;PORTA COMO IN/OUT DIGITAL
			CLRF	ANSEL		;PORTB COMO IN/OUT DIGITAL
			CLRF	ANSELH		;PORTB CONFIGURADO COMO OUT
			BCF	STATUS,RP0	;PONE EN 0 RP0 DEL STATUS
			BCF	STATUS,RP1	;PONE EN 0 RP1 DEL STATUS									
			;MANDAN AL BANCO 0

SELECT0		CALL		LEER
			BTFSS		STATUS,Z	;CHECAR SI BIT Z = 1, DATO CORRECTO
			GOTO	ENCENDER0
			GOTO	APAGAR
SELECT1		CALL		LEER
			BTFSS		STATUS,Z	;CHECAR SI BIT Z = 1, DATO CORRECTO
			GOTO	ENCENDER1
			GOTO	APAGAR
SELECT2		CALL		LEER
			BTFSS		STATUS,Z	;CHECAR SI BIT Z = 1, DATO CORRECTO
			GOTO	ENCENDER2
			GOTO	APAGAR
SELECT3		CALL		LEER
			BTFSS		STATUS,Z	;CHECAR SI BIT Z = 1, DATO CORRECTO
			GOTO	ENCENDER3
			GOTO	APAGAR
SELECT4		CALL		LEER
			BTFSS		STATUS,Z	;CHECAR SI BIT Z = 1, DATO CORRECTO
			GOTO	ENCENDER4
			GOTO	APAGAR
SELECT5		CALL		LEER
			BTFSS		STATUS,Z	;CHECAR SI BIT Z = 1, DATO CORRECTO
			GOTO	ENCENDER5
			GOTO	APAGAR
SELECT6		CALL		LEER
			BTFSS		STATUS,Z	;CHECAR SI BIT Z = 1, DATO CORRECTO
			GOTO	ENCENDER6
			GOTO	APAGAR
SELECT7		CALL		LEER
			BTFSS		STATUS,Z	;CHECAR SI BIT Z = 1, DATO CORRECTO
			GOTO	ENCENDER7
			GOTO	APAGAR
SELECT8		CALL		LEER
			BTFSS		STATUS,Z	;CHECAR SI BIT Z = 1, DATO CORRECTO
			GOTO	ENCENDER8
			GOTO	APAGAR
SELECT9		CALL		LEER
			BTFSS		STATUS,Z	;CHECAR SI BIT Z = 1, DATO CORRECTO
			GOTO	ENCENDER9
			GOTO	APAGAR
SELECTA		CALL		LEER
			BTFSS		STATUS,Z	;CHECAR SI BIT Z = 1, DATO CORRECTO
			GOTO	ENCENDERA
			GOTO	APAGAR
SELECTb		CALL		LEER
			BTFSS		STATUS,Z	;CHECAR SI BIT Z = 1, DATO CORRECTO
			GOTO	ENCENDERb
			GOTO	APAGAR
SELECTC		CALL		LEER
			BTFSS		STATUS,Z	;CHECAR SI BIT Z = 1, DATO CORRECTO
			GOTO	ENCENDERC
			GOTO	APAGAR
SELECTd		CALL		LEER
			BTFSS		STATUS,Z	;CHECAR SI BIT Z = 1, DATO CORRECTO
			GOTO	ENCENDERd
			GOTO	APAGAR
SELECTE		CALL		LEER
			BTFSS		STATUS,Z	;CHECAR SI BIT Z = 1, DATO CORRECTO
			GOTO	ENCENDERE
			GOTO	APAGAR
SELECTF		CALL		LEER
			BTFSS		STATUS,Z	;CHECAR SI BIT Z = 1, DATO CORRECTO
			GOTO	ENCENDERF
			GOTO	APAGAR

ENCENDER0	MOVLW	B'00111111'	;0
			MOVWF	PORTB			
			CALL	TIME
			GOTO	SELECT1
ENCENDER1	MOVLW	B'00000110'	;1
			MOVWF	PORTB
			CALL	TIME
			GOTO	SELECT2			
ENCENDER2	MOVLW	B'01011011'	;2
			MOVWF	PORTB			
			CALL	TIME
			GOTO	SELECT3	
ENCENDER3	MOVLW	B'01001111'	;3
			MOVWF	PORTB
			CALL	TIME
			GOTO	SELECT4	
ENCENDER4	MOVLW	B'01100110'	;4
			MOVWF	PORTB
			CALL	TIME
			GOTO	SELECT5	
ENCENDER5	MOVLW	B'01101101'	;5
			MOVWF	PORTB
			CALL	TIME
			GOTO	SELECT6	
ENCENDER6	MOVLW	B'01111101'	;6
			MOVWF	PORTB
			CALL	TIME
			GOTO	SELECT7	
ENCENDER7	MOVLW	B'00000111'	;7
			MOVWF	PORTB
			CALL	TIME
			GOTO	SELECT8	
ENCENDER8	MOVLW	B'01111111'	;8
			MOVWF	PORTB
			CALL	TIME
			GOTO	SELECT9	
ENCENDER9	MOVLW	B'01101111'	;9
			MOVWF	PORTB
			CALL	TIME
			GOTO	SELECTA	
ENCENDERA	MOVLW	B'01110111'	;A
			MOVWF	PORTB
			CALL	TIME
			GOTO	SELECTb
ENCENDERb   MOVLW	B'01111100'	;b
			MOVWF	PORTB
			CALL	TIME
			GOTO	SELECTC	
ENCENDERC	MOVLW	B'00111001'	;C
			MOVWF	PORTB
			CALL	TIME
			GOTO	SELECTd	
ENCENDERd	MOVLW	B'01011110'	;d
			MOVWF	PORTB
			CALL	TIME
			GOTO	SELECTE
ENCENDERE	MOVLW	B'01111001'	;E
			MOVWF	PORTB
			CALL	TIME
			GOTO	SELECTF	
ENCENDERF	MOVLW	B'01110001'	;F
			MOVWF	PORTB
			CALL	TIME
			GOTO	SELECT0			
			
LEER		MOVF 		PORTA,W		;MOVER PORTA -> W	
			XORLW		0X00		;HACER LA COMPARACIÓN DE VALORES
			RETURN
			

APAGAR		CLRF 	PORTB
			GOTO 	SELECT0			


TIME			MOVLW	.100
			MOVWF	R0
			MOVLW	.50
			MOVWF	R1
			MOVLW	.2
			MOVWF	R2

AQUI			DECFSZ	R0,F
			GOTO	AQUI
			DECFSZ	R1,F
			GOTO	AQUI
			DECFSZ	R2,F
			GOTO	AQUI
			RETURN
			END